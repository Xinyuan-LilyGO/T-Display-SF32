## examples/empty_prj/project/Kconfig.tmp
```kconfig
source "E:/PRJ/SIFLI/OpenSiFli/SiFli-SDK-2.4.6/customer/boards/t-display-sf32/hcpu/Kconfig.board"
source "$SIFLI_SDK/customer/boards/Kconfig.v2"
source "$SIFLI_SDK/Kconfig.v2"
rsource "Kconfig.proj"
```

## examples/multimedia/lvgl/lvgl_v8_media/project/Kconfig.tmp
```kconfig
source "E:/PRJ/SIFLI/OpenSiFli/sifli-sdk/customer/boards/t-display-sf32/hcpu/Kconfig.board"
source "$SIFLI_SDK/customer/boards/Kconfig.v2"
source "$SIFLI_SDK/Kconfig.v2"
rsource "Kconfig.proj"
```
